## config/west.yml
```yaml
manifest:
  remotes:
    - name: zmkfirmware
      url-base: https://github.com/zmkfirmware
    - name: urob
      url-base: https://github.com/urob
    - name: brmejia
      url-base: https://github.com/brmejia
  projects:
    - name: zmk
      remote: zmkfirmware
      import: app/west.yml
      revision: v0.3

    # ZMK modules
    # - name: zmk-adaptive-key
    #   path: modules/zmk/adaptive-key
    #   remote: urob
    #   revision: v0.3
    # - name: zmk-auto-layer
    #   path: modules/zmk/auto-layer
    #   remote: urob
    #   revision: v0.3
    # - name: zmk-leader-key
    #   path: modules/zmk/leader-key
    #   remote: urob
    #   revision: v0.3
    # - name: zmk-tri-state
    #   path: modules/zmk/tri-state
    #   remote: urob
    #   revision: v0.3
    # - name: zmk-unicode
    #   path: modules/zmk/unicode
    #   remote: urob
    #   revision: v0.3

    - name: zmk-helpers
      remote: brmejia
      revision: fix/redox-keymap

  self:
    path: config
```
